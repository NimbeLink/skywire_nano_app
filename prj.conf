## CMakeLists.txt
```
###
 # \file
 #
 # \brief Builds the Skywire Nano application
 #
 # (C) NimbeLink Corp. 2020
 #
 # All rights reserved except as explicitly granted in the license agreement
 # between NimbeLink Corp. and the designated licensee.  No other use or
 # disclosure of this software is permitted. Portions of this software may be
 # subject to third party license terms as specified in this software, and such
 # portions are excluded from the preceding copyright notice of NimbeLink Corp.
 ##

cmake_minimum_required(VERSION 3.8.2)

set(PROJECT_ROOT        "${CMAKE_CURRENT_LIST_DIR}")
set(REPOSITORY_ROOT     "${PROJECT_ROOT}/..")
set(NANO_SDK_ROOT       "${REPOSITORY_ROOT}/skywire_nano_sdk/")

################################################################
#
# Toolchain
#
################################################################

# Set up the location of the toolchain for Zephyr
set(ENV{ZEPHYR_TOOLCHAIN_VARIANT}   gnuarmemb)
set(ENV{GNUARMEMB_TOOLCHAIN_PATH}   ${REPOSITORY_ROOT}/toolchain)

################################################################
#
# Boards
#
################################################################

# Set up the location of our custom boards
set(DTS_ROOT        ${NANO_SDK_ROOT})
set(BOARD_ROOT      ${NANO_SDK_ROOT})
set(BOARD           skywire_nano_app)

################################################################
#
# Environment
#
################################################################

include(${REPOSITORY_ROOT}/nrf/cmake/boilerplate.cmake)
include(${REPOSITORY_ROOT}/zephyr/cmake/app/boilerplate.cmake NO_POLICY_SCOPE)
project(app)

################################################################
#
# Application
#
################################################################

# Add in our examples
add_subdirectory(examples/)

# Add our own source
FILE(
    GLOB_RECURSE
    newSources
    ABSOLUTE
        "${PROJECT_ROOT}/src/*.c"
        "${PROJECT_ROOT}/src/*.cpp"
)

list(APPEND sources ${newSources})

# Add the sources to our target
target_sources(app PRIVATE ${sources})

zephyr_include_directories(
    kernel/include
    ${ARCH_DIR}/${ARCH}/include
    ${PROJECT_ROOT}
    ${NANO_SDK_ROOT}/src
    ${PROJECT_BINARY_DIR}
)

################################################################
#
# DFU
#
################################################################

# Note our starting points, which are generated by our build system
set(unsignedAppHex ${PROJECT_BINARY_DIR}/zephyr/zephyr.hex)
set(unsignedAppBin ${PROJECT_BINARY_DIR}/zephyr/zephyr.bin)

# Sign the HEX output for the sake of manually flashing a device
set(signedAppHex ${PROJECT_BINARY_DIR}/zephyr/app_signed.hex)

# Sign the BIN output for a signed update file
set(signedAppBin ${PROJECT_BINARY_DIR}/zephyr/app_signed_update.bin)

# Make a target for signing our app HEX file and signing our app BIN file
add_custom_target(
    generateAdditionalBinaries
    ALL
    DEPENDS
        "${unsignedAppHex}"
        "${unsignedAppBin}"
    BYPRODUCTS
        "${signedAppHex}"
        "${signedAppBin}"

    COMMAND
        python ${REPOSITORY_ROOT}/mcuboot/scripts/imgtool.py
        sign
        --key "${PROJECT_ROOT}/test_sign.pem"
        --header-size ${CONFIG_TEXT_SECTION_OFFSET}
        --align ${CONFIG_DT_FLASH_WRITE_BLOCK_SIZE}
        --slot-size ${CONFIG_FLASH_LOAD_SIZE}
        --version "1.0.0"
        "${unsignedAppHex}"
        "${signedAppHex}"

    COMMAND
        python ${REPOSITORY_ROOT}/mcuboot/scripts/imgtool.py
        sign
        --key "${PROJECT_ROOT}/test_sign.pem"
        --header-size ${CONFIG_TEXT_SECTION_OFFSET}
        --align ${CONFIG_DT_FLASH_WRITE_BLOCK_SIZE}
        --pad
        --slot-size ${CONFIG_FLASH_LOAD_SIZE}
        --version "1.0.0"
        "${unsignedAppBin}"
        "${signedAppBin}"

    COMMAND
        west skywire format
        --input="${signedAppBin}"
        --type="application"
        --output-file="${signedAppBin}"
)

add_custom_target(
    additionalAppTargets

    DEPENDS
        ${signedAppHex}
        ${signedAppBin}

    additionalAppTargetOutputs
)
```

## Kconfig
```
###
 # \file
 #
 # \brief Provides configurations for the Skywire Nano widget
 #
 # (C) NimbeLink Corp. 2020
 #
 # All rights reserved except as explicitly granted in the license agreement
 # between NimbeLink Corp. and the designated licensee.  No other use or
 # disclosure of this software is permitted. Portions of this software may be
 # subject to third party license terms as specified in this software, and such
 # portions are excluded from the preceding copyright notice of NimbeLink Corp.
 ##

# Include the Zephyr kernel's configuration in a separate menu
menu "Zephyr Kernel"
    source "${ZEPHYR_BASE}/Kconfig.zephyr"
endmenu

# Include the Skywire Nano SDK's configuration (which provides its own menu)
source "${ZEPHYR_BASE}/../skywire_nano_sdk/Kconfig"

menu "Examples"
    source "${ZEPHYR_BASE}/../app/examples/Kconfig"
endmenu
```

## west.yml
```
# The west manifest for the NimbeLink Skywire Nano

manifest:
    remotes:
        -   name:           nimbelink
            url-base:       https://github.com/NimbeLink

        -   name:           nrf_connect_sdk
            url-base:       https://github.com/NordicPlayground

        -   name:           zephyr_project
            url-base:       https://github.com/zephyrproject-rtos

        -   name:           armmbed
            url-base:       https://github.com/ARMmbed

    projects:
        # Projects for the Skywire Nano
        -   name:           skywire_nano_sdk
            remote:         nimbelink
            repo-path:      skywire_nano_sdk
            revision:       v1.0.0
            west-commands:  scripts/west-commands.yml

        # Projects for the nRF Connect SDK
        #
        # Nordic has their own fork of the Zephyr RTOS, which contains a
        # handful of tweaks.
        -   name:           nrf
            remote:         nimbelink
            repo-path:      fw-nrfconnect-nrf
            revision:       v1.2.0-nlsdk-rc2
            west-commands:  scripts/west-commands.yml

        -   name:           mcuboot
            remote:         nrf_connect_sdk
            repo-path:      fw-nrfconnect-mcuboot
            revision:       v1.4.99-ncs2

        -   name:           mcumgr
            path:           modules/lib/mcumgr
            remote:         nrf_connect_sdk
            repo-path:      fw-nrfconnect-mcumgr
            revision:       v0.0.1-ncs1

        -   name:           nrfxlib
            path:           nrfxlib
            remote:         nrf_connect_sdk
            revision:       v1.2.0

        -   name:           zephyr
            remote:         nimbelink
            repo-path:      zephyr
            revision:       v2.1.99-nlsdk-rc1
            west-commands:  scripts/west-commands.yml

        # Projects for Zephyr
        #
        # Which... doesn't contain Zephyr itself.
        -   name:           nffs
            path:           modules/fs/nffs
            remote:         zephyr_project
            revision:       bc62a2fa9d98ddb5d633c932ea199bc68e10f194

        -   name:           hal_nordic
            path:           modules/hal/nordic
            remote:         zephyr_project
            revision:       474ad9ab42305c0d18e39183163a69ed2442c02b

        -   name:           segger
            path:           modules/debug/segger
            remote:         zephyr_project
            revision:       6fcf61606d6012d2c44129edc033f59331e268bc

        -   name:           mbedtls
            path:           modules/crypto/mbedtls
            remote:         zephyr_project
            revision:       4f1e8f5a78dc08aa42a47cc1ad059cce558c26c3

        -   name:           tinycbor
            path:           modules/lib/tinycbor
            remote:         zephyr_project
            revision:       0fc68fceacd1efc1ce809c5880c380f3d98b7b6e

        -   name:           ci-tools
            path:           tools/ci-tools
            remote:         zephyr_project
            revision:       c083680dd5e281218ddb47d0ceac5c5fd5619749

        -   name:           net-tools
            path:           tools/net-tools
            remote:         zephyr_project
            revision:       30b7efa827b04d2e47840716b0372737fe7d6c92

        -   name:           mbedtls-nrf
            path:           mbedtls
            remote:         armmbed
            repo-path:      mbedtls
            revision:       mbedtls-2.16.4

    self:
        path: app
```

## prj.conf
```kconfig
###
 # \file
 #
 # \brief Configures the Skywire Nano widget firmware
 #
 # (C) NimbeLink Corp. 2020
 #
 # All rights reserved except as explicitly granted in the license agreement
 # between NimbeLink Corp. and the designated licensee.  No other use or
 # disclosure of this software is permitted. Portions of this software may be
 # subject to third party license terms as specified in this software, and such
 # portions are excluded from the preceding copyright notice of NimbeLink Corp.
 ##

################################################################
#
# Environment
#
################################################################

# Compiler
CONFIG_NEWLIB_LIBC=y
CONFIG_NEWLIB_LIBC_NANO=y
CONFIG_CPLUSPLUS=y
CONFIG_STD_CPP17=y
CONFIG_LIB_CPLUSPLUS=y
CONFIG_EXCEPTIONS=n
CONFIG_RTTI=n
CONFIG_SIZE_OPTIMIZATIONS=y

################################################################
#
# Hardware
#
################################################################

CONFIG_HW_CC310=n

CONFIG_CLOCK_CONTROL_NRF=n
CONFIG_CLOCK_CONTROL=n

CONFIG_GPIO=y

CONFIG_PWM=y
CONFIG_PWM_NRFX=y
CONFIG_PWM_0=y

# UART interface
CONFIG_SERIAL=y
CONFIG_UART_INTERRUPT_DRIVEN=y
CONFIG_UART_1_NRF_UARTE=y
CONFIG_UART_1_NRF_FLOW_CONTROL=n

################################################################
#
# Application
#
################################################################

# Include the Skywire Nano SDK
CONFIG_NIMBELINK_SDK=y

# General config
CONFIG_STACK_SENTINEL=n
CONFIG_HW_STACK_PROTECTION=y
CONFIG_ASSERT=y
CONFIG_REBOOT=y
CONFIG_POSIX_CLOCK=y
CONFIG_FLOAT=y
CONFIG_FP_SHARING=y
CONFIG_MULTITHREADING=y
CONFIG_TICKLESS_CAPABLE=y

# Main thread
CONFIG_MAIN_THREAD_PRIORITY=7

# Heap and stacks
CONFIG_HEAP_MEM_POOL_SIZE=8192
CONFIG_MAIN_STACK_SIZE=1024
CONFIG_SYSTEM_WORKQUEUE_STACK_SIZE=4096

# Instruction cache will be configured for us
CONFIG_NRF_ENABLE_ICACHE=n

# Make sure we link against the Secure services offered by the host application
CONFIG_ARM_ENTRY_VENEERS_LIB_NAME="../../skywire_nano_sdk/libentryveneers.a"
CONFIG_ARM_FIRMWARE_USES_SECURE_ENTRY_FUNCS=y

################################################################
#
# Libraries
#
################################################################

# Permissions are managed for us, as we're the non-secure application
CONFIG_SPM=n

CONFIG_TEXT_SECTION_OFFSET=0x200

# BSDLIB is out of our hands
CONFIG_BSD_LIBRARY=n

# Have kernel output
CONFIG_CONSOLE=y
CONFIG_CONSOLE_SUBSYS=y
CONFIG_CONSOLE_HANDLER=y
CONFIG_CONSOLE_GETCHAR=y
CONFIG_UART_CONSOLE=y

################################################################
#
# Applets
#
################################################################
CONFIG_WIDGET_BLINKY_EXAMPLE=y
```

## src/main.c
```c
/*
 * Copyright (c) 2020 Nordic Semiconductor ASA
 *
 * SPDX-License-Identifier: LicenseRef-BSD-5-Clause-Nordic
 */

#include <zephyr.h>
#include <stdio.h>
#include <stdlib.h>
#if defined(CONFIG_BSD_LIB)
#include <modem/lte_lc.h>
#include <modem/bsdlib.h>
#include <modem/at_cmd.h>
#include <modem/at_notif.h>
#include <modem/modem_info.h>
#include <bsd.h>
#endif
#include <net/aws_iot.h>
#include <power/reboot.h>
#include <dfu/mcuboot.h>
#include <cJSON.h>
#include <cJSON_os.h>

BUILD_ASSERT(!IS_ENABLED(CONFIG_LTE_AUTO_INIT_AND_CONNECT),
		"This sample does not support LTE auto-init and connect");

#define APP_TOPICS_COUNT CONFIG_AWS_IOT_APP_SUBSCRIPTION_LIST_COUNT

static struct k_delayed_work shadow_update_work;
static struct k_delayed_work shadow_update_version_work;

K_SEM_DEFINE(lte_connected, 0, 1);

static int json_add_obj(cJSON *parent, const char *str, cJSON *item)
{
	cJSON_AddItemToObject(parent, str, item);

	return 0;
}

static int json_add_str(cJSON *parent, const char *str, const char *item)
{
	cJSON *json_str;

	json_str = cJSON_CreateString(item);
	if (json_str == NULL) {
		return -ENOMEM;
	}

	return json_add_obj(parent, str, json_str);
}

static int json_add_number(cJSON *parent, const char *str, double item)
{
	cJSON *json_num;

	json_num = cJSON_CreateNumber(item);
	if (json_num == NULL) {
		return -ENOMEM;
	}

	return json_add_obj(parent, str, json_num);
}

static int shadow_update(bool version_number_include)
{
	int err;
	char *message;
	int64_t message_ts = k_uptime_get();
	int16_t bat_voltage = 0;

#if defined(CONFIG_BSD_LIBRARY)
	/* Request battery voltage data from the modem. */
	err = modem_info_short_get(MODEM_INFO_BATTERY, &bat_voltage);
	if (err != sizeof(bat_voltage)) {
		printk("modem_info_short_get, error: %d\n", err);
		return err;
	}
#endif

	cJSON *root_obj = cJSON_CreateObject();
	cJSON *state_obj = cJSON_CreateObject();
	cJSON *reported_obj = cJSON_CreateObject();

	if (root_obj == NULL || state_obj == NULL || reported_obj == NULL) {
		cJSON_Delete(root_obj);
		cJSON_Delete(state_obj);
		cJSON_Delete(reported_obj);
		err = -ENOMEM;
		return err;
	}

	if (version_number_include) {
		err = json_add_str(reported_obj, "app_version",
				    CONFIG_APP_VERSION);
	} else {
		err = 0;
	}

	err += json_add_number(reported_obj, "batv", bat_voltage);
	err += json_add_number(reported_obj, "ts", message_ts);
	err += json_add_obj(state_obj, "reported", reported_obj);
	err += json_add_obj(root_obj, "state", state_obj);

	if (err) {
		printk("json_add, error: %d\n", err);
		goto cleanup;
	}

	message = cJSON_Print(root_obj);
	if (message == NULL) {
		printk("cJSON_Print, error: returned NULL\n");
		err = -ENOMEM;
		goto cleanup;
	}

	struct aws_iot_data tx_data = {
		.qos = MQTT_QOS_0_AT_MOST_ONCE,
		.topic.type = AWS_IOT_SHADOW_TOPIC_UPDATE,
		.ptr = message,
		.len = strlen(message)
	};

	printk("Publishing: %s to AWS IoT broker\n", message);

	err = aws_iot_send(&tx_data);
	if (err) {
		printk("aws_iot_send, error: %d\n", err);
	}

	k_free(message);

cleanup:

	cJSON_Delete(root_obj);

	return err;
}

static void shadow_update_work_fn(struct k_work *work)
{
	int err;

	err = shadow_update(false);
	if (err) {
		printk("shadow_update, error: %d\n", err);
	}

	printk("Next data publication in %d seconds\n",
	       CONFIG_PUBLICATION_INTERVAL_SECONDS);

	k_delayed_work_submit(&shadow_update_work,
			      K_SECONDS(CONFIG_PUBLICATION_INTERVAL_SECONDS));
}

static void shadow_update_version_work_fn(struct k_work *work)
{
	int err;

	err = shadow_update(true);
	if (err) {
		printk("shadow_update, error: %d\n", err);
	}
}

void aws_iot_event_handler(const struct aws_iot_evt *const evt)
{
	switch (evt->type) {
	case AWS_IOT_EVT_CONNECTING:
		printk("AWS_IOT_EVT_CONNECTING\n");
		break;
	case AWS_IOT_EVT_CONNECTED:
		printk("AWS_IOT_EVT_CONNECTED\n");

		if (evt->data.persistent_session) {
			printk("Persistent session enabled\n");
		}

#if defined(CONFIG_BSD_LIBRARY)
		/** Successfully connected to AWS IoT broker, mark image as
		 *  working to avoid reverting to the former image upon reboot.
		 */
		boot_write_img_confirmed();
#endif

		/** Send version number to AWS IoT broker to verify that the
		 *  FOTA update worked.
		 */
		k_delayed_work_submit(&shadow_update_version_work, K_NO_WAIT);

		/** Start sequential shadow data updates.
		 */
		k_delayed_work_submit(&shadow_update_work,
				K_SECONDS(CONFIG_PUBLICATION_INTERVAL_SECONDS));

#if defined(CONFIG_BSD_LIBRARY)
		int err = lte_lc_psm_req(true);
		if (err) {
			printk("Requesting PSM failed, error: %d\n", err);
		}
#endif
		break;
	case AWS_IOT_EVT_READY:
		printk("AWS_IOT_EVT_READY\n");
		break;
	case AWS_IOT_EVT_DISCONNECTED:
		printk("AWS_IOT_EVT_DISCONNECTED\n");
		k_delayed_work_cancel(&shadow_update_work);
		break;
	case AWS_IOT_EVT_DATA_RECEIVED:
		printk("AWS_IOT_EVT_DATA_RECEIVED\n");
		break;
	case AWS_IOT_EVT_FOTA_START:
		printk("AWS_IOT_EVT_FOTA_START\n");
		break;
	case AWS_IOT_EVT_FOTA_ERASE_PENDING:
		printk("AWS_IOT_EVT_FOTA_ERASE_PENDING\n");
		printk("Disconnect LTE link or reboot\n");
#if defined(CONFIG_BSD_LIBRARY)
		err = lte_lc_offline();
		if (err) {
			printk("Error disconnecting from LTE\n");
		}
#endif
		break;
	case AWS_IOT_EVT_FOTA_ERASE_DONE:
		printk("AWS_FOTA_EVT_ERASE_DONE\n");
		printk("Reconnecting the LTE link");
#if defined(CONFIG_BSD_LIBRARY)
		err = lte_lc_connect();
		if (err) {
			printk("Error connecting to LTE\n");
		}
#endif
		break;
	case AWS_IOT_EVT_FOTA_DONE:
		printk("AWS_IOT_EVT_FOTA_DONE\n");
		printk("FOTA done, rebooting device\n");
		aws_iot_disconnect();
		sys_reboot(0);
		break;
	case AWS_IOT_EVT_FOTA_DL_PROGRESS:
		printk("AWS_IOT_EVT_FOTA_DL_PROGRESS, (%d%%)",
		       evt->data.fota_progress);
	case AWS_IOT_EVT_ERROR:
		printk("AWS_IOT_EVT_ERROR, %d\n", evt->data.err);
		break;
	default:
		printk("Unknown AWS IoT event type: %d\n", evt->type);
		break;
	}
}

static void work_init(void)
{
	k_delayed_work_init(&shadow_update_work, shadow_update_work_fn);
	k_delayed_work_init(&shadow_update_version_work,
			    shadow_update_version_work_fn);
}

#if defined(CONFIG_BSD_LIBRARY)
static void lte_handler(const struct lte_lc_evt *const evt)
{
	switch (evt->type) {
	case LTE_LC_EVT_NW_REG_STATUS:
		if ((evt->nw_reg_status != LTE_LC_NW_REG_REGISTERED_HOME) &&
		     (evt->nw_reg_status != LTE_LC_NW_REG_REGISTERED_ROAMING)) {
			break;
		}

		printk("Network registration status: %s\n",
			evt->nw_reg_status == LTE_LC_NW_REG_REGISTERED_HOME ?
			"Connected - home network" : "Connected - roaming");

		k_sem_give(&lte_connected);
		break;
	case LTE_LC_EVT_PSM_UPDATE:
		printk("PSM parameter update: TAU: %d, Active time: %d\n",
			evt->psm_cfg.tau, evt->psm_cfg.active_time);
		break;
	case LTE_LC_EVT_EDRX_UPDATE: {
		char log_buf[60];
		ssize_t len;

		len = snprintf(log_buf, sizeof(log_buf),
			       "eDRX parameter update: eDRX: %f, PTW: %f",
			       evt->edrx_cfg.edrx, evt->edrx_cfg.ptw);
		if (len > 0) {
			printk("%s\n", log_buf);
		}
		break;
	}
	case LTE_LC_EVT_RRC_UPDATE:
		printk("RRC mode: %s\n",
			evt->rrc_mode == LTE_LC_RRC_MODE_CONNECTED ?
			"Connected" : "Idle");
		break;
	case LTE_LC_EVT_CELL_UPDATE:
		printk("LTE cell changed: Cell ID: %d, Tracking area: %d\n",
			evt->cell.id, evt->cell.tac);
		break;
	default:
		break;
	}
}

static void modem_configure(void)
{
	int err;

	if (IS_ENABLED(CONFIG_LTE_AUTO_INIT_AND_CONNECT)) {
		/* Do nothing, modem is already configured and LTE connected. */
	} else {
		err = lte_lc_init_and_connect_async(lte_handler);
		if (err) {
			printk("Modem could not be configured, error: %d\n",
				err);
			return;
		}
	}
}

static void at_configure(void)
{
	int err;

	err = at_notif_init();
	__ASSERT(err == 0, "AT Notify could not be initialized.");
	err = at_cmd_init();
	__ASSERT(err == 0, "AT CMD could not be established.");
}

static void bsd_lib_modem_dfu_handler(void)
{
	int err;

	err = bsdlib_init();

	switch (err) {
	case MODEM_DFU_RESULT_OK:
		printk("Modem update suceeded, reboot\n");
		sys_reboot(SYS_REBOOT_COLD);
		break;
	case MODEM_DFU_RESULT_UUID_ERROR:
	case MODEM_DFU_RESULT_AUTH_ERROR:
		printk("Modem update failed, error: %d\n", err);
		printk("Modem will use old firmware\n");
		sys_reboot(SYS_REBOOT_COLD);
		break;
	case MODEM_DFU_RESULT_HARDWARE_ERROR:
	case MODEM_DFU_RESULT_INTERNAL_ERROR:
		printk("Modem update malfunction, error: %d, reboot\n", err);
		sys_reboot(SYS_REBOOT_COLD);
		break;
	default:
		break;
	}

	at_configure();
}
#endif

static int app_topics_subscribe(void)
{
	int err;
	char custom_topic[75] = "my-custom-topic/example";
	char custom_topic_2[75] = "my-custom-topic/example_2";

	const struct aws_iot_topic_data topics_list[APP_TOPICS_COUNT] = {
		[0].str = custom_topic,
		[0].len = strlen(custom_topic),
		[1].str = custom_topic_2,
		[1].len = strlen(custom_topic)
	};

	err = aws_iot_subscription_topics_add(topics_list,
					      ARRAY_SIZE(topics_list));
	if (err) {
		printk("aws_iot_subscription_topics_add, error: %d\n", err);
	}

	return err;
}

void main(void)
{
	int err;

	printk("The AWS IoT sample started, version: %s\n", CONFIG_APP_VERSION);

	cJSON_Init();

#if defined(CONFIG_BSD_LIBRARY)
	bsd_lib_modem_dfu_handler();
#endif

	err = aws_iot_init(NULL, aws_iot_event_handler);
	if (err) {
		printk("AWS IoT library could not be initialized, error: %d\n",
		       err);
	}

	/** Subscribe to customizable non-shadow specific topics
	 *  to AWS IoT backend.
	 */
	err = app_topics_subscribe();
	if (err) {
		printk("Adding application specific topics failed, error: %d\n",
			err);
	}

	work_init();
#if defined(CONFIG_BSD_LIBRARY)
	modem_configure();

	err = modem_info_init();
	if (err) {
		printk("Failed initializing modem info module, error: %d\n",
			err);
	}

	k_sem_take(&lte_connected, K_FOREVER);
#endif

	err = aws_iot_connect(NULL);
	if (err) {
		printk("aws_iot_connect failed: %d\n", err);
	}
}
```

## src/main.cpp
```c
/**
 * \file
 *
 * \brief A basic widget starting point
 *
 * (C) NimbeLink Corp. 2020
 *
 * All rights reserved except as explicitly granted in the license agreement
 * between NimbeLink Corp. and the designated licensee.  No other use or
 * disclosure of this software is permitted. Portions of this software may be
 * subject to third party license terms as specified in this software, and such
 * portions are excluded from the preceding copyright notice of NimbeLink Corp.
 */
#include <chrono>
#include <cstdint>
#include <cstdlib>
#include <cstring>

#include <zephyr.h>

#if CONFIG_WIDGET_BLINKY_EXAMPLE
#include "examples/blinky/blinky.h"
#endif

#if CONFIG_WIDGET_BUTTON_EXAMPLE
#include "examples/button/button.h"
#endif

#if CONFIG_WIDGET_ACCEL_EXAMPLE
#include "examples/accel/accel.h"
#endif

#if CONFIG_WIDGET_CELL_EXAMPLE
#include "examples/cell/cell.h"
#endif

#if CONFIG_WIDGET_DASHBOARD_EXAMPLE
#include "examples/dashboard/dashboard.h"
#if CONFIG_WIDGET_CELL_EXAMPLE
#include "examples/dashboard/elements/display_cell.h"
#endif
#endif

#if CONFIG_WIDGET_SOCKET_EXAMPLE
#include "examples/socket/socket.h"
#if CONFIG_WIDGET_CELL_EXAMPLE
#include "examples/socket/posters/post_cell.h"
#endif
#endif

#include "examples/utils.h"

#include "nimbelink/sdk/secure_services/at.h"
#include "nimbelink/sdk/secure_services/kernel.h"

using namespace NimbeLink::Examples;
using namespace NimbeLink::Sdk;

void main(void)
{
#   if CONFIG_CELL_CAGE_SIM || CONFIG_WIDGET_SOCKET_EXAMPLE
    // allow the modem to boot up properly before trying to change the sim
    k_sleep(K_SECONDS(20));

    static constexpr const std::string_view commands[] = {
        "AT+CFUN=4",
        "AT#SIMSELECT=1",
        "AT+CFUN=1"
    };

    for (std::size_t i = 0; i < std::size(commands); i++)
    {

        char resp[100];
        SecureServices::At::Result result;
        SecureServices::At::Error error;
        int32_t ret = SecureServices::At::RunCommand(&result, &error, std::data(commands[i]), std::size(commands[i]), resp, 100, nullptr);

        if (ret == 0)
        {
            if (result != 0)
            {
                Utils::PrintError(commands[i], result, error);
            }
        }
    }
#   endif

#   if CONFIG_WIDGET_BLINKY_EXAMPLE
    static Blinky blinky;
#   endif

#   if CONFIG_WIDGET_BUTTON_EXAMPLE
    static Button button;
#   endif


#   if CONFIG_WIDGET_ACCEL_EXAMPLE
    static Accel accel;
#   endif

#   if CONFIG_WIDGET_CELL_EXAMPLE
    static NimbeLink::Examples::Cell cell;
#   endif

#   if CONFIG_WIDGET_DASHBOARD_EXAMPLE
    static Dashboard dashboard(CONFIG_DASHBOARD_X, CONFIG_DASHBOARD_Y, CONFIG_DASHBOARD_W, CONFIG_DASHBOARD_H);
#   if CONFIG_WIDGET_ACCEL_EXAMPLE
    dashboard.RegisterElement(accel);
#   endif
#   if CONFIG_WIDGET_CELL_EXAMPLE
    static CellDisplay display(cell);
    dashboard.RegisterElement(display);
#   endif
#   if CONFIG_WIDGET_BUTTON_EXAMPLE
    dashboard.RegisterElement(button);
#   endif
#   endif

#   if CONFIG_WIDGET_SOCKET_EXAMPLE
    static Socket socket;
#   if CONFIG_WIDGET_CELL_EXAMPLE
    static CellPoster poster(cell);
    socket.RegisterData(poster);
#   endif
#   endif
}
```
